/**
 * @cliArgs --device "AM64x_beta" --package "ALV" --part "Default" --context "r5fss0-0" --product "MCU_PLUS_SDK_AM64x@08.01.00"
 * @versions {"tool":"1.10.0+2163"}
 */

/**
 * Import the modules used in this configuration.
 */
const pruicss    = scripting.addModule("/drivers/pruicss/pruicss", {}, false);
const pruicss1   = pruicss.addInstance();
const debug_log  = scripting.addModule("/kernel/dpl/debug_log");
const mpu_armv7  = scripting.addModule("/kernel/dpl/mpu_armv7", {}, false);
const mpu_armv71 = mpu_armv7.addInstance();
const mpu_armv72 = mpu_armv7.addInstance();
const mpu_armv73 = mpu_armv7.addInstance();
const mpu_armv74 = mpu_armv7.addInstance();
const mpu_armv75 = mpu_armv7.addInstance();
const mpu_armv76 = mpu_armv7.addInstance();
const adc        = scripting.addModule("/pru_io/adc/adc", {}, false);
const adc1       = adc.addInstance();

/**
 * Write custom configuration values to the imported modules.
 */
debug_log.enableUartLog        = true;
debug_log.uartLog.$name        = "CONFIG_UART_CONSOLE";
debug_log.uartLog.UART.$assign = "USART0";

mpu_armv71.$name             = "CONFIG_MPU_REGION0";
mpu_armv71.size              = 31;
mpu_armv71.attributes        = "Device";
mpu_armv71.accessPermissions = "Supervisor RD+WR, User RD";
mpu_armv71.allowExecute      = false;

mpu_armv72.$name             = "CONFIG_MPU_REGION1";
mpu_armv72.size              = 15;
mpu_armv72.accessPermissions = "Supervisor RD+WR, User RD";

mpu_armv73.$name             = "CONFIG_MPU_REGION2";
mpu_armv73.baseAddr          = 0x41010000;
mpu_armv73.size              = 15;
mpu_armv73.accessPermissions = "Supervisor RD+WR, User RD";

mpu_armv74.$name             = "CONFIG_MPU_REGION3";
mpu_armv74.accessPermissions = "Supervisor RD+WR, User RD";
mpu_armv74.baseAddr          = 0x70000000;
mpu_armv74.size              = 21;

mpu_armv75.$name             = "CONFIG_MPU_REGION4";
mpu_armv75.baseAddr          = 0x60000000;
mpu_armv75.size              = 28;
mpu_armv75.accessPermissions = "Supervisor RD, User RD";

mpu_armv76.$name    = "CONFIG_MPU_REGION5";
mpu_armv76.baseAddr = 0x80000000;
mpu_armv76.size     = 31;

adc1.$name                                          = "CONFIG_ADC0";
adc1.adcConfig[0].$name                                = "CONFIG_ADS8598H_PINMUX0";
adc1.adcConfig[0].PRU_ICSSG0_IEP.$assign               = "PRU_ICSSG0_IEP1";
adc1.adcConfig[0].PRU_ICSSG0_IEP.EDC_SYNC_OUT0.$assign = "ball.R2";
adc1.adcConfig[0].PRU_ICSSG0_PRU.$assign               = "PRU_ICSSG0_PRU0";
adc1.adcConfig[0].PRU_ICSSG0_PRU.GPI0.$assign          = "ball.Y1";
adc1.adcConfig[0].PRU_ICSSG0_PRU.GPI1.$assign          = "ball.R4";
adc1.adcConfig[0].PRU_ICSSG0_PRU.GPI2.$assign          = "ball.U2";
adc1.adcConfig[0].PRU_ICSSG0_PRU.GPI3.$assign          = "ball.V2";
adc1.adcConfig[0].PRU_ICSSG0_PRU.GPI4.$assign          = "ball.AA2";
adc1.adcConfig[0].PRU_ICSSG0_PRU.GPI5.$assign          = "ball.R3";
adc1.adcConfig[0].PRU_ICSSG0_PRU.GPI6.$assign          = "ball.T3";
adc1.adcConfig[0].PRU_ICSSG0_PRU.GPI7.$assign          = "ball.T1";
adc1.adcConfig[0].PRU_ICSSG0_PRU.GPI8.$assign          = "ball.T2";
adc1.adcConfig[0].PRU_ICSSG0_PRU.GPI9.$assign          = "ball.W6";
adc1.adcConfig[0].PRU_ICSSG0_PRU.GPI10.$assign         = "ball.AA5";
adc1.adcConfig[0].PRU_ICSSG0_PRU.GPI11.$assign         = "ball.Y3";
adc1.adcConfig[0].PRU_ICSSG0_PRU.GPI12.$assign         = "ball.AA3";
adc1.adcConfig[0].PRU_ICSSG0_PRU.GPI13.$assign         = "ball.R6";
adc1.adcConfig[0].PRU_ICSSG0_PRU.GPI14.$assign         = "ball.V4";
adc1.adcConfig[0].PRU_ICSSG0_PRU.GPI15.$assign         = "ball.T5";
adc1.adcConfig[0].PRU_ICSSG0_PRU.GPI16.$assign         = "ball.U4";
adc1.adcConfig[0].PRU_ICSSG0_PRU.GPI17.$assign         = "ball.U1";
adc1.adcConfig[0].PRU_ICSSG0_PRU.GPO18.$assign         = "ball.V1";
adc1.adcConfig[0].PRU_ICSSG0_PRU.GPO19.$assign         = "ball.W1";
adc1.adcConfig[0].power1.$name                         = "ADC_POWER_ENABLE_PIN_1";
adc1.adcConfig[0].power1.GPIO.$assign                  = "GPIO0";
adc1.adcConfig[0].power1.GPIO.gpioPin.rx               = false;
adc1.adcConfig[0].power1.GPIO.gpioPin.$assign          = "ball.T19";
adc1.adcConfig[0].power2.$name                         = "ADC_POWER_ENABLE_PIN_2";
adc1.adcConfig[0].power2.GPIO.$assign                  = "GPIO0";
adc1.adcConfig[0].power2.GPIO.gpioPin.rx               = false;
adc1.adcConfig[0].power2.GPIO.gpioPin.$assign          = "ball.T17";
adc1.adcConfig[0].power3.$name                         = "ADC_POWER_ENABLE_PIN_3";
adc1.adcConfig[0].power3.GPIO.$assign                  = "GPIO0";
adc1.adcConfig[0].power3.GPIO.gpioPin.rx               = false;
adc1.adcConfig[0].power3.GPIO.gpioPin.$assign          = "ball.V19";
adc1.adcConfig[0].oversampling0.$name                  = "CONFIG_GPIO_OVERSAMPLING_0";
adc1.adcConfig[0].oversampling0.GPIO.$assign           = "GPIO0";
adc1.adcConfig[0].oversampling0.GPIO.gpioPin.pu_pd     = "nopull";
adc1.adcConfig[0].oversampling0.GPIO.gpioPin.rx        = false;
adc1.adcConfig[0].oversampling0.GPIO.gpioPin.$assign   = "ball.P16";
adc1.adcConfig[0].oversampling1.$name                  = "CONFIG_GPIO_OVERSAMPLING_1";
adc1.adcConfig[0].oversampling1.GPIO.$assign           = "GPIO0";
adc1.adcConfig[0].oversampling1.GPIO.gpioPin.pu_pd     = "nopull";
adc1.adcConfig[0].oversampling1.GPIO.gpioPin.rx        = false;
adc1.adcConfig[0].oversampling1.GPIO.gpioPin.$assign   = "ball.N19";
adc1.adcConfig[0].oversampling2.$name                  = "CONFIG_GPIO_OVERSAMPLING_2";
adc1.adcConfig[0].oversampling2.GPIO.$assign           = "GPIO0";
adc1.adcConfig[0].oversampling2.GPIO.gpioPin.pu_pd     = "nopull";
adc1.adcConfig[0].oversampling2.GPIO.gpioPin.rx        = false;
adc1.adcConfig[0].oversampling2.GPIO.gpioPin.$assign   = "ball.W19";
adc1.adcConfig[0].range.$name                          = "CONFIG_GPIO6";
adc1.adcConfig[0].range.GPIO.$assign                   = "GPIO0";
adc1.adcConfig[0].range.GPIO.gpioPin.rx                = false;
adc1.adcConfig[0].range.GPIO.gpioPin.$assign           = "ball.Y20";
adc1.adcConfig[0].ref.$name                            = "CONFIG_GPIO_REFERENCE";
adc1.adcConfig[0].ref.GPIO.$assign                     = "GPIO0";
adc1.adcConfig[0].ref.GPIO.gpioPin.rx                  = false;
adc1.adcConfig[0].ref.GPIO.gpioPin.$assign             = "ball.R18";
adc1.adcConfig[0].stby.$name                           = "CONFIG_GPIO_STANDBY";
adc1.adcConfig[0].stby.GPIO.$assign                    = "GPIO0";
adc1.adcConfig[0].stby.GPIO.gpioPin.rx                 = false;
adc1.adcConfig[0].stby.GPIO.gpioPin.$assign            = "ball.Y18";
adc1.adcConfig[0].par.$name                            = "CONFIG_GPIO9";
adc1.adcConfig[0].par.GPIO.$assign                     = "GPIO0";
adc1.adcConfig[0].par.GPIO.gpioPin.rx                  = false;
adc1.adcConfig[0].par.GPIO.gpioPin.$assign             = "ball.N16";
adc1.adcConfig[0].rst.$name                            = "ADC_RESET_PIN";
adc1.adcConfig[0].rst.GPIO.$assign                     = "GPIO0";
adc1.adcConfig[0].rst.GPIO.gpioPin.rx                  = false;
adc1.adcConfig[0].rst.GPIO.gpioPin.$assign             = "ball.R19";
adc1.pruIpc.create(1);
adc1.pruIpc[0].$name                                   = "CONFIG_PRU_IPC0";
adc1.pruIpc[0].blockSize                               = 256;
adc1.pruIpc[0].noOfBlocks                              = 2;
adc1.pruIpc[0].rxIntcMapping.$name                     = "CONFIG_ICSS0_INTC_MAPPING0";

pruicss1.$name                  = "CONFIG_PRU_ICSS0";
adc1.icss                       = pruicss1;
pruicss1.intcMapping.create(1);
pruicss1.intcMapping[0].$name   = "CONFIG_ICSS0_INTC_MAPPING1";
pruicss1.intcMapping[0].event   = "22";
pruicss1.intcMapping[0].channel = "1";

/**
 * Pinmux solution for unlocked pins/peripherals. This ensures that minor changes to the automatic solver in a future
 * version of the tool will not impact the pinmux you originally saw.  These lines can be completely deleted in order to
 * re-solve from scratch.
 */
debug_log.uartLog.UART.RXD.$suggestSolution = "ball.D15";
debug_log.uartLog.UART.TXD.$suggestSolution = "ball.C16";
